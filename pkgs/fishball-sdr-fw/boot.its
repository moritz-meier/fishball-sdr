## pkgs/fishball-sdr-fw/boot.its
```
/dts-v1/;
// Memory addresses implement the recommendation in https://docs.kernel.org/arch/arm/booting.html
/ {
        description = "Fishball FIT Image";
        #address-cells = <1>;

        images {
                kernel {
                        description = "Kernel";
                        data = /incbin/("@kernel@");
                        type = "kernel";
                        arch = "arm";
                        os = "linux";
                        compression = "none";
                        load = <0x2000000>; // just after 32 MiB
                        entry = <0x2000000>;
                        hash {
                                algo = "crc32";
                        };
                };
                fdt {
                        description = "DTB";
                        data = /incbin/("@dtb@");
                        type = "flat_dt";
                        arch = "arm";
                        compression = "none";
                        load = <0x8000000>; // just after 128 MiB
                        hash {
                                algo = "crc32";
                        };
                };
                initrd {
                        description = "Initrd";
                        data = /incbin/("@initrd@");
                        type = "ramdisk";
                        arch = "arm";
                        os = "linux";
                        compression = "none";
                        load = <0x8100000>; // just behind the dtb
                        hash {
                                algo = "crc32";
                        };
                };
        };

        configurations {
                default = "standard";
                standard {
                        description = "Standard Boot";
                        kernel = "kernel";
                        fdt = "fdt";
                        ramdisk = "initrd";
                        hash {
                                algo = "crc32";
                        };
                };
        };

};              
```
