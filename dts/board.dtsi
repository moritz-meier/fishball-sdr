&qspi {
	flash@0 {
		compatible = "jedec,spi-nor";
		reg = <0>;
        spi-max-frequency = <4000000>;
	};
};

&cpu0 {
	operating-points = <666667 1000000 333334 1000000 166667 1000000 83334 1000000 41667 1000000>;
};
